/**
 * @cliArgs --board "/ti/boards/CC1352P_2_LAUNCHXL" --device "CC1352P1F3RGZ" --part "Default" --package "RGZ" --rtos "nortos" --product "simplelink_cc13xx_cc26xx_sdk@8.32.00.07"
 * @versions {"tool":"1.21.1+3772"}
 */

/**
 * Import the modules used in this configuration.
 */
const GPIO   = scripting.addModule("/ti/drivers/GPIO");
const Power  = scripting.addModule("/ti/drivers/Power");
const Timer  = scripting.addModule("/ti/drivers/Timer", {}, false);
const Timer1 = Timer.addInstance();
const LED    = scripting.addModule("/ti/drivers/apps/LED", {}, false);
const LED1   = LED.addInstance();
const LED2   = LED.addInstance();

/**
 * Write custom configuration values to the imported modules.
 */
const CCFG              = scripting.addModule("/ti/devices/CCFG", {}, false);
CCFG.ccfgTemplate.$name = "ti_devices_CCFG_CCFGCC26XXTemplate0";

Timer1.$name               = "CONFIG_TIMER_0";
Timer1.timerType           = "32 Bits";
Timer1.timerInstance.$name = "CONFIG_GPTIMER_0";

LED1.$name     = "CONFIG_LED_1";
LED1.$hardware = system.deviceData.board.components.LED_GREEN;

LED2.$name     = "CONFIG_LED_0";
LED2.$hardware = system.deviceData.board.components.LED_RED;

/**
 * Pinmux solution for unlocked pins/peripherals. This ensures that minor changes to the automatic solver in a future
 * version of the tool will not impact the pinmux you originally saw.  These lines can be completely deleted in order to
 * re-solve from scratch.
 */
Timer1.timerInstance.timer.$suggestSolution = "GPTM1";
LED1.ledPin.$suggestSolution                = "boosterpack.40";
LED2.ledPin.$suggestSolution                = "boosterpack.39";
