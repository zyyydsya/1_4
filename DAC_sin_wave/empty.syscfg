/**
 * @cliArgs --board "/ti/boards/CC1352P_2_LAUNCHXL" --device "CC1352P1F3RGZ" --part "Default" --package "RGZ" --rtos "nortos" --product "simplelink_cc13xx_cc26xx_sdk@8.32.00.07"
 * @versions {"tool":"1.21.1+3772"}
 */

/**
 * Import the modules used in this configuration.
 */
const DAC    = scripting.addModule("/ti/drivers/DAC", {}, false);
const DAC1   = DAC.addInstance();
const GPIO   = scripting.addModule("/ti/drivers/GPIO");
const Power  = scripting.addModule("/ti/drivers/Power");
const Timer  = scripting.addModule("/ti/drivers/Timer", {}, false);
const Timer1 = Timer.addInstance();

/**
 * Write custom configuration values to the imported modules.
 */
DAC1.$name              = "CONFIG_DAC_0";
DAC1.dac.$assign        = "ADC0";
DAC1.dac.dacPin.$assign = "boosterpack.2";

const ADC   = scripting.addModule("/ti/drivers/ADC", {}, false);
const ADC1  = ADC.addInstance({}, false);
DAC1.auxADC = ADC1;

const CCFG              = scripting.addModule("/ti/devices/CCFG", {}, false);
CCFG.ccfgTemplate.$name = "ti_devices_CCFG_CCFGCC26XXTemplate0";

Timer1.$name               = "CONFIG_TIMER_0";
Timer1.timerType           = "32 Bits";
Timer1.timerInstance.$name = "CONFIG_GPTIMER_0";

/**
 * Pinmux solution for unlocked pins/peripherals. This ensures that minor changes to the automatic solver in a future
 * version of the tool will not impact the pinmux you originally saw.  These lines can be completely deleted in order to
 * re-solve from scratch.
 */
Timer1.timerInstance.timer.$suggestSolution = "GPTM1";
