/**
 * @cliArgs --board "/ti/boards/CC1352P_2_LAUNCHXL" --device "CC1352P1F3RGZ" --part "Default" --package "RGZ" --rtos "nortos" --product "simplelink_cc13xx_cc26xx_sdk@8.32.00.07"
 * @versions {"tool":"1.21.1+3772"}
 */

/**
 * Import the modules used in this configuration.
 */
const GPIO    = scripting.addModule("/ti/drivers/GPIO");
const Power   = scripting.addModule("/ti/drivers/Power");
const Button  = scripting.addModule("/ti/drivers/apps/Button", {}, false);
const Button1 = Button.addInstance();
const LED     = scripting.addModule("/ti/drivers/apps/LED", {}, false);
const LED1    = LED.addInstance();

/**
 * Write custom configuration values to the imported modules.
 */
const CCFG              = scripting.addModule("/ti/devices/CCFG", {}, false);
CCFG.ccfgTemplate.$name = "ti_devices_CCFG_CCFGCC26XXTemplate0";

Button1.$name     = "CONFIG_BUTTON_0";
Button1.$hardware = system.deviceData.board.components["BTN-1"];

LED1.$name     = "CONFIG_LED_0";
LED1.$hardware = system.deviceData.board.components.LED_RED;

/**
 * Pinmux solution for unlocked pins/peripherals. This ensures that minor changes to the automatic solver in a future
 * version of the tool will not impact the pinmux you originally saw.  These lines can be completely deleted in order to
 * re-solve from scratch.
 */
Button1.button.$suggestSolution = "boosterpack.13";
LED1.ledPin.$suggestSolution    = "boosterpack.39";
